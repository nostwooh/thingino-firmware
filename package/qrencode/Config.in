## package/qrencode/Config.in
```kconfig
config BR2_PACKAGE_QRENCODE
	bool "qrencode"
	select BR2_PACKAGE_LIBPNG
	help
	  Generate QR-code symbols. Provides the `qrencode` command-line tool.
```

## package/qrencode/config.in
```kconfig
config BR2_PACKAGE_QRENCODE
	bool "qrencode"
	help
	  Generate QR-code symbols. Provides the `qrencode` command-line tool.
```

## package/thingino-homekit/Config.in
```kconfig
config BR2_PACKAGE_THINGINO_HOMEKIT
	bool "Thingino HomeKit camera"
	select BR2_PACKAGE_GO2RTC
	select BR2_PACKAGE_QRENCODE
	help
	  Expose the standard Thingino RTSP camera feed as a native HomeKit camera.
```
